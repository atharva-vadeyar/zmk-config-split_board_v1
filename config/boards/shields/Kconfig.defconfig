## config/boards/shields/Kconfig.defconfig
```kconfig
if SHIELD_VAD_BOARD_LEFT

config ZMK_KEYBOARD_NAME
    default "Vad Board"

config ZMK_SPLIT_KEYBOARD_ROLE_CENTRAL
    default y

endif

if SHIELD_VAD_BOARD_RIGHT || SHIELD_VAD_BOARD_LEFT

config ZMK_SPLIT
    default y

endif
```

## config/boards/shields/Kconfig.shield
```kconfig
config SHIELD_VAD_BOARD_RIGHT
    def_bool $(shields_list_contains, corne_right)

config SHIELD_VAD_BOARD_LEFT
    def_bool $(shields_list_contains, corne_left)
```

## config/boards/shields/test_left/Kconfig.defconfig
```kconfig
if SHIELD_TEST_LEFT

config ZMK_KEYBOARD_NAME
    default "TestLeft"

config ZMK_SPLIT_ROLE_CENTRAL
    default y

endif

if SHIELD_TEST_RIGHT || SHIELD_TEST_LEFT

config ZMK_SPLIT 
    default y

endif
```
