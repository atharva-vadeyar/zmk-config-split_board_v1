#include "vad_board.dtsi"

/ {
    kscan0: kscan0 {
        compatible = "zmk, kscan-gpio-matrix";
        diode-direction = "col2row";
        wakeup-source;

        row-gpios
        = <&pro_micro 21 (GPIO_ACTIVE_LOW | GPIO_PULL_UP) >
        , <&pro_micro 20 (GPIO_ACTIVE_LOW | GPIO_PULL_UP) >
        , <&pro_micro 19 (GPIO_ACTIVE_LOW | GPIO_PULL_UP) >
        , <&pro_micro 18 (GPIO_ACTIVE_LOW | GPIO_PULL_UP) >
        ;

        col-gpios
        = <&pro_micro 8 (GPIO_ACTIVE_LOW | GPIO_PULL_UP) >
        , <&pro_micro 7 (GPIO_ACTIVE_LOW | GPIO_PULL_UP) >
        , <&pro_micro 6 (GPIO_ACTIVE_LOW | GPIO_PULL_UP) >
        , <&pro_micro 5 (GPIO_ACTIVE_LOW | GPIO_PULL_UP) >
        , <&pro_micro 4 (GPIO_ACTIVE_LOW | GPIO_PULL_UP) >
        , <&pro_micro 3 (GPIO_ACTIVE_LOW | GPIO_PULL_UP) >
        , <&pro_micro 2 (GPIO_ACTIVE_LOW | GPIO_PULL_UP) >
        , <&pro_micro 9 (GPIO_ACTIVE_LOW | GPIO_PULL_UP) >
        ;
    };
};